## ms5/esp32_reference/sdkconfig.defaults
```kconfig
CONFIG_IDF_TARGET="esp32s3"
CONFIG_ESPTOOLPY_FLASHSIZE_16MB=y
CONFIG_PARTITION_TABLE_CUSTOM=y
CONFIG_PARTITION_TABLE_CUSTOM_FILENAME="partitions.fabric-4m.csv"
CONFIG_PARTITION_TABLE_FILENAME="partitions.fabric-4m.csv"
CONFIG_BOOTLOADER_APP_ROLLBACK_ENABLE=y
```
